## infra/main/Kconfig.projbuild
```kconfig
menu "Configuração do Wifi Configuration"

    config ESP_WIFI_SSID
        string "Nome do Wifi"
        default "SSID" 
        help
            Nome da rede Wifi.

    config ESP_WIFI_PASSWORD
        string "Senha do Wifi solicitado"
        default "SENHA"
        help
            Senha do WiFi (WPA or WPA2).

    config ESP_MAXIMUM_RETRY
        int 7
        default 5
        help
            Configure o valor máximo de tentativas de conexão.
endmenu
```

## lcd_buzzer/Kconfig.projbuild
```kconfig
menu "Configuração do Wifi Configuration"

    config ESP_WIFI_SSID
        string "Nome do Wifi"
        default "SSID" 
        help
            Nome da rede Wifi.

    config ESP_WIFI_PASSWORD
        string "Senha do Wifi solicitado"
        default "SENHA"
        help
            Senha do WiFi (WPA or WPA2).

    config ESP_MAXIMUM_RETRY
        int 7
        default 5
        help
            Configure o valor máximo de tentativas de conexão.
endmenu

menu "Example Configuration"

    choice EXAMPLE_LCD_CONTROLLER
        prompt "LCD controller model"
        default EXAMPLE_LCD_CONTROLLER_SSD1306
        help
            Select LCD controller model

        config EXAMPLE_LCD_CONTROLLER_SSD1306
            bool "SSD1306"

        config EXAMPLE_LCD_CONTROLLER_SH1107
            bool "SH1107"
    endchoice

    if EXAMPLE_LCD_CONTROLLER_SSD1306
        choice EXAMPLE_SSD1306_HEIGHT
            prompt "SSD1306 Height in pixels"
            default EXAMPLE_SSD1306_HEIGHT_64
            help
                Height of the display in pixels. a.k.a vertical resolution

            config EXAMPLE_SSD1306_HEIGHT_64
                bool "64"
            config EXAMPLE_SSD1306_HEIGHT_32
                bool "32"
        endchoice

        config EXAMPLE_SSD1306_HEIGHT
            int
            default 64 if EXAMPLE_SSD1306_HEIGHT_64
            default 32 if EXAMPLE_SSD1306_HEIGHT_32
    endif

endmenu
```

## rgb_led/main/Kconfig.projbuild
```kconfig
menu "Configuração do Wifi Configuration"

    config ESP_WIFI_SSID
        string "Nome do Wifi"
        default "SSID" 
        help
            Nome da rede Wifi.

    config ESP_WIFI_PASSWORD
        string "Senha do Wifi solicitado"
        default "SENHA"
        help
            Senha do WiFi (WPA or WPA2).

    config ESP_MAXIMUM_RETRY
        int 7
        default 5
        help
            Configure o valor máximo de tentativas de conexão.
endmenu

config EXAMPLE_WIFI_LISTEN_INTERVAL
    int "WiFi listen interval"
    default 3
    help
        Interval for station to listen to beacon from AP. The unit of listen interval is one beacon interval.
        For example, if beacon interval is 100 ms and listen interval is 3, the interval for station to listen
        to beacon is 300 ms.

config EXAMPLE_WIFI_BEACON_TIMEOUT
    int "WiFi beacon timeout"
    default 6
    range 6 30
    help
        For Station, If the station does not receive a beacon frame from the connected SoftAP during the
        inactive time, disconnect from SoftAP. Default 6s.

choice EXAMPLE_POWER_SAVE_MODE
    prompt "power save mode"
    default EXAMPLE_POWER_SAVE_MIN_MODEM
    help
        Power save mode for the esp32 to use. Modem sleep mode includes minimum and maximum power save modes.
        In minimum power save mode, station wakes up every DTIM to receive beacon. Broadcast data will not be
        lost because it is transmitted after DTIM. However, it can not save much more power if DTIM is short
        for DTIM is determined by AP.
        In maximum power save mode, station wakes up every listen interval to receive beacon. Broadcast data
        may be lost because station may be in sleep state at DTIM time. If listen interval is longer, more power
        is saved but broadcast data is more easy to lose.

    config EXAMPLE_POWER_SAVE_NONE
        bool "none"
    config EXAMPLE_POWER_SAVE_MIN_MODEM
        bool "minimum modem"
    config EXAMPLE_POWER_SAVE_MAX_MODEM
        bool "maximum modem"
endchoice
```
